## results/task2/board-20260825/bounded-200/artifacts/axvisor-task123-zephyr-fp-rr.its
```
/dts-v1/;

/ {
	description = "AxVisor ATK-DLRK3588 unified Zephyr 4.4.2 Task 1/2/3 FP-RR";
	#address-cells = <1>;

	images {
		kernel-1 {
			description = "AxVisor FP-RR with StarryOS AI and unified Zephyr 4.4.2";
			data = /incbin/("/home/huhu/tgoskits-very_special/results/task2/board-20260825/bounded-200/artifacts/axvisor-task123-zephyr-fp-rr.bin");
			type = "kernel";
			arch = "arm64";
			os = "linux";
			compression = "none";
			load = <0x00400000>;
			entry = <0x00400000>;
			hash-1 { algo = "sha256"; };
		};

		fdt-1 {
			description = "ATK-DLRK3588 host device tree";
			data = /incbin/("/home/huhu/atk-bringup/atk-dlrk3588-starry.dtb");
			type = "flat_dt";
			arch = "arm64";
			compression = "none";
			load = <0x08300000>;
			hash-1 { algo = "sha256"; };
		};
	};

	configurations {
		default = "conf-1";
		conf-1 {
			description = "Unified Zephyr 4.4.2 Task 1/2/3 FP-RR RAM boot";
			kernel = "kernel-1";
			fdt = "fdt-1";
		};
	};
};
```
